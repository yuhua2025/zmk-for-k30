## config/boards/shields/k30/Kconfig.defconfig
```kconfig
# Copyright (c) 2020 The ZMK Contributors
# SPDX-License-Identifier: MIT

if SHIELD_K30

config ZMK_KEYBOARD_NAME
	default "k30"

endif
```

## config/boards/shields/k30/Kconfig.shield
```kconfig
# Copyright (c) 2020 The ZMK Contributors
# SPDX-License-Identifier: MIT

config SHIELD_K30
	def_bool $(shields_list_contains,k30)
	select ZMK_LED_BREATHING if ZMK_RGB_UNDERGLOW
	select GPIO  # 始终选择GPIO以支持LED控制

# 确保GPIO驱动被启用以支持LED控制
config GPIO
	default y if SHIELD_K30
```

## config/shields/k30/Kconfig.shield
```kconfig
# Copyright (c) 2020 The ZMK Contributors
# SPDX-License-Identifier: MIT

config SHIELD_K30
	def_bool $(shields_list_contains,k30)
```

## config/west.yml
```yaml
manifest:
  remotes:
    - name: zmkfirmware
      url-base: https://github.com/zmkfirmware
  projects:
    - name: zmk
      remote: zmkfirmware  # 关键修改：使用官方仓库
      revision: main       # 关键修改：使用main分支
      import: app/west.yml
  self:
    path: config
```
